#include "Fx2.h"
#include "fx2regs.h"

#include "stdlib.h"
#include "string.h"

#include "iic_comm.h"

#include "ssd1306.h"
	
const code au8Font8x8[]= {
    0x00,0x00,0x00,0x00,0x00,0x00,0x00,0x00,       // ASCII -  32
    0x00,0x00,0x00,0x5F,0x5F,0x00,0x00,0x00,       // ASCII -  33
    0x00,0x00,0x03,0x07,0x00,0x07,0x03,0x00,       // ASCII -  34
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    0x00,0x3D,0x7D,0x40,0x41,0x3D,0x7C,0x40,       // ASCII - 129
};	   		

		
unsigned char* m_pFramebuffer;

void writeCommand(unsigned char cmd)
{
	I2CStart();
	I2CSend(0x78);  //Slave address,SA0=0
	I2CSend(0x00);	//write command
	I2CSend(cmd);
	I2CStop();
}	   

void writeData(unsigned char cmd)
{
	I2CStart();
	I2CSend(0x78);  //Slave address,SA0=0
	I2CSend(0x40);	//write data
	I2CSend(cmd);
	I2CStop();
}
void ssd1306_initalize()
{

	//m_pFramebuffer = (unsigned char*)malloc(SSD1306_FBSIZE);
	//if(m_pFramebuffer == 0){
	//	return;
	//}
	//memset(m_pFramebuffer,0,SSD1306_FBSIZE);//clear it.
	//write command to the screen registers.
	writeCommand(SSD1306_CMD_DISPLAY_OFF);//0xAE
	writeCommand(0xD5);//Set Memory Addressing Mode
	writeCommand(0x80);//00,Horizontal Addressing Mode;01,Vertical Addressing Mode;10,Page Addressing Mode (RESET);11,Invalid
	writeCommand(0xA8);//Set Page Start Address for Page Addressing Mode,0-7
	writeCommand(0x3F);//--set segment re-map 0 to 127
	writeCommand(0xD3);//--set multiplex ratio(1 to 64)
	writeCommand(0x00);//
	writeCommand(0x40);//0xa4,Output follows RAM content;0xa5,Output ignores RAM content
	writeCommand(0x8D);//-set display offset
	writeCommand(0x14);//-not offset
	writeCommand(0x20);//--set display clock divide ratio/oscillator frequency
	writeCommand(0x00);//--set divide ratio
	writeCommand(0xA1);//--set pre-charge period
	writeCommand(0xC8);//
	writeCommand(0xDA);//--set com pins hardware configuration
	writeCommand(0x12);//--set vcomh
	writeCommand(0x81);//0x20,0.77xVcc
	writeCommand(0xCF);//--set DC-DC enable
	writeCommand(0xD9);
	writeCommand(0xF1);
	writeCommand(0xDB);
	writeCommand(0x40);
	writeCommand(0xA4);
	writeCommand(0xA6);
	writeCommand(SSD1306_CMD_DISPLAY_ON);//--0XAF

	//delay(10);//wait for the screen loaded.
}

void ssd1306_clear()
{
	int i;

	writeCommand(SSD1306_SETLOWCOLUMN | 0x0);  // low col = 0
    writeCommand(SSD1306_SETHIGHCOLUMN | 0x0);  // hi col = 0
    writeCommand(SSD1306_SETSTARTLINE | 0x0); // line #0
	writeCommand(0xb0);
	
    for (i=0; i<1024; i++) 
    {
      writeData(0x00);
    }
}
		 
void ssd1306_printchar(unsigned char dat)
{
	unsigned char i;
	for (i=0; i<8; i++) 
    {
      writeData(au8Font8x8[(dat-32)*8+i]);
    }
}

void ssd1306_draw()
{
	int i,j;

	writeCommand(SSD1306_SETLOWCOLUMN | 0x0);  // low col = 0
    writeCommand(SSD1306_SETHIGHCOLUMN | 0x0);  // hi col = 0
    writeCommand(SSD1306_SETSTARTLINE | 0x0); // line #0

	for (i=0;i<1024;i++) ;
	//writeData(~nBitmapDot[i]);	  
}

void ssd1306_printf(unsigned char dat[])
{
	int i=0;
	int j=0;

	writeCommand(SSD1306_SETLOWCOLUMN | 0x0);  // low col = 0
    writeCommand(SSD1306_SETHIGHCOLUMN | 0x0);  // hi col = 0
    writeCommand(SSD1306_SETSTARTLINE | 0x0); // line #0
	writeCommand(0xb0);

	for (i=0;i< strlen(dat);i++)
	{
		if ((dat[i]==0x0d) ||(dat[i]==0x0a) || (dat[i]==0x0b))
			for (j=0;j<8;j++)
				writeData(au8Font8x8[j]);
		else	
			for (j=0;j<8;j++)
				writeData(au8Font8x8[(dat[i]-32)*8+j]);	
	}
	for (i=0;i<1024-8*strlen(dat);i++)
		writeData(0x00); 
}